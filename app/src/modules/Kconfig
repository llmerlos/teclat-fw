## app/src/modules/Kconfig
```kconfig
#
# Copyright (c) 2021 Nordic Semiconductor ASA
#
# SPDX-License-Identifier: LicenseRef-Nordic-5-Clause
#

config CAF_SAMPLE_LED_STATE
	bool "Sample LED state module"
	depends on CAF_LED_EVENTS
	depends on CAF_BUTTON_EVENTS
	help
	  If enabled, the application specific, LED state module, is included
	  in the application and controls LEDs based on buttons presses.

if CAF_SAMPLE_LED_STATE

module = CAF_SAMPLE_LED_STATE
module-str = caf sample led state
source "subsys/logging/Kconfig.template.log_config"

endif # CAF_SAMPLE_LED_STATE

config CAF_MY_KEYMAP
	bool "Converts button events to HID"
	depends on CAF_BUTTON_EVENTS
	depends on CAF_LED_EVENTS
	help
	  If enabled, the application specific, converts the button presses
	  to keycodes

if CAF_MY_KEYMAP

module = CAF_MY_KEYMAP
module-str = caf my keymap
source "subsys/logging/Kconfig.template.log_config"

endif # CAF_MY_KEYMAP
```
